


#include "auxFunc.h"
#include <inttypes.h>  // Requerido para PRIu16
#include "esp_log.h"
//unsigned short updcrc (unsigned short ch, unsigned short crc);


//Eejmplo con tabla de updcrc, con tabla en flash
#define updcrc(cp, crc)( crctab[((crc >> 8) & 255)]^ (crc << 8) ^ cp)


static unsigned short crctab [256] = {
0x0000,  0x1021,  0x2042,  0x3063,  0x4084,  0x50a5,  0x60c6,  0x70e7,
0x8108,  0x9129,  0xa14a,  0xb16b,  0xc18c,  0xd1ad,  0xe1ce,  0xf1ef,
0x1231,  0x0210,  0x3273,  0x2252,  0x52b5,  0x4294,  0x72f7,  0x62d6,
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0x6e17,  0x7e36,  0x4e55,  0x5e74,  0x2e93,  0x3eb2,  0x0ed1,  0x1ef0,
};



uint16_t calccrc(uint8_t *message){
    uint16_t crc = 0;

    for (; *message != 0; message++)
        crc = updcrc(*message, crc);
        
    //ESP_LOGI("crc  bascio calculado", "El valor es: %" PRIu16, crc);
    return crc;
}

/*
Esta funcion recive la CARACTERES de la UART pero necesito trabajar con los bits que representar ese caracter.
O sea 30A3 deberia procesarse como 0x30 0xA3
*/

uint8_t hexchar_to_val(uint8_t c) {
    unsigned char rta=0;
    if (c >= '0' && c <= '9') //return c - '0';
        rta=c-'0';
    if (c >= 'A' && c <= 'F') //return c - 'A' + 10;
        rta=(c-'A')+10;
    if (c >= 'a' && c <= 'f') //return c - 'a' + 10;
        rta=(c-'a')+10;
    return (rta&0x0f);              
}



/*

//Ejemplo sin tabla, de updcrc
#define BITS_PER_CHAR    8
unsigned short updcrc (unsigned short ch, unsigned short crc){
    register short counter = BITS_PER_CHAR;
    register short temp    = crc;
    while (--counter >= 0){

        if (temp & 0x8000)  {
            temp <<= 1;
            temp += (((ch <<= 1) & 0x0100) != 0);
            temp ^= 0x1021;
        } else {
            temp <<= 1;
            temp += (((ch <<= 1) & 0x0100) != 0);
        }

    }


    return(temp);
}
*/

/*
//Cracion de la fuking tabla
#include <stdio.h>
#define MAX_CHAR       256
#define BITS_CHAR      8
#define SIGN_BIT       0x8000
#define POLY           0x1021
unsigned short crctab [MAX_CHAR];
main (){
    unsigned short ch;
    unsigned short workval;
    unsigned short bit;
    unsigned short carry;
    for (ch = 0; ch != MAX_CHAR; ch++)  {
        workval = ch << BITS_CHAR;
        for (bit = BITS_CHAR; bit != 0; bit--)  {
            carry = (workval & SIGN_BIT);
            workval <<= 1;
        if (carry)
            workval ^= POLY;
        }
        crctab[ch] = workval;
    }
    for (ch = 0; ch != MAX_CHAR; ch++)
        printf("0x%04x\n", crctab[ch]);
}
*/

